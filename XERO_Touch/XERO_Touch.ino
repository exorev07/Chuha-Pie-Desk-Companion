/*
 * XERO-Style Animated Eyes with Touch Control
 * Based on XERO project with added TTP223 touch sensor support
 * 
 * Pin Connections:
 * OLED GND  -> ESP32 GND
 * OLED VDD  -> ESP32 3.3V
 * OLED SCK  -> ESP32 GPIO 18 (HSPI CLK)
 * OLED SDA  -> ESP32 GPIO 23 (HSPI MOSI)
 * OLED RES  -> ESP32 GPIO 4 (Reset)
 * OLED DC   -> ESP32 GPIO 2 (Data/Command)
 * OLED CS   -> ESP32 GPIO 5 (Chip Select)
 * 
 * TTP223 VCC -> ESP32 3.3V
 * TTP223 GND -> ESP32 GND
 * TTP223 SIG -> ESP32 GPIO 15
 */

#include <Wire.h>
#include <Adafruit_GFX.h>
#include <Adafruit_SSD1306.h>
#include <SPI.h>

#define SCREEN_WIDTH 128
#define SCREEN_HEIGHT 64

// Pin definitions
#define OLED_MOSI   23
#define OLED_CLK    18
#define OLED_DC     2
#define OLED_CS     5
#define OLED_RESET  4
#define TOUCH_PIN   15

Adafruit_SSD1306 display(SCREEN_WIDTH, SCREEN_HEIGHT,
  OLED_MOSI, OLED_CLK, OLED_DC, OLED_RESET, OLED_CS);

// Animation control
byte currentFrame = 0;
byte currentAnimation = 0; // 0=idle, 1=happy, 2=surprised, 3=sleepy, 4=love
unsigned long lastFrameTime = 0;
int frameDelay = 60; // ms between frames

// Touch sensor state
bool lastTouchState = false;
unsigned long lastTouchTime = 0;

// Animation sequences (frame ranges)
struct AnimationSequence {
  byte startFrame;
  byte endFrame;
  byte fps;
  bool loop;
};

AnimationSequence animations[] = {
  {0, 50, 16, true},    // 0: Idle/normal blinking
  {51, 80, 20, false},  // 1: Happy
  {81, 100, 18, false}, // 2: Surprised
  {101, 130, 12, false},// 3: Sleepy
  {131, 160, 16, false} // 4: Love/Heart eyes
};

// Simple animation frames (simplified for demo - you can add more complex ones)
// In a full implementation, you'd include all the bitmap frames from XERO

// Idle eyes - open
const unsigned char frame_idle_1[] PROGMEM = {
  0x00, 0x00, 0x00, 0x00, 0x00, 0x00, 0x00, 0x00, 0x00, 0x00, 0x00, 0x00, 0x00, 0x00, 0x00, 0x00,
  0x00, 0x00, 0x00, 0x00, 0x00, 0x00, 0x00, 0x00, 0x00, 0x00, 0x00, 0x00, 0x00, 0x00, 0x00, 0x00,
  0x00, 0x00, 0x00, 0x00, 0x00, 0x00, 0x00, 0x00, 0x00, 0x00, 0x00, 0x00, 0x00, 0x00, 0x00, 0x00,
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  0x00, 0x00, 0x00, 0x00, 0x00, 0x00, 0x00, 0x00, 0x00, 0x00, 0x00, 0x00, 0x00, 0x00, 0x00, 0x00
};

// Happy eyes ^_^
const unsigned char frame_happy[] PROGMEM = {
  0x00, 0x00, 0x00, 0x00, 0x00, 0x00, 0x00, 0x00, 0x00, 0x00, 0x00, 0x00, 0x00, 0x00, 0x00, 0x00,
  0x00, 0x00, 0x00, 0x00, 0x00, 0x00, 0x00, 0x00, 0x00, 0x00, 0x00, 0x00, 0x00, 0x00, 0x00, 0x00,
  0x00, 0x00, 0x00, 0x00, 0x00, 0x00, 0x00, 0x00, 0x00, 0x00, 0x00, 0x00, 0x00, 0x00, 0x00, 0x00,
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  0x00, 0x00, 0x00, 0x00, 0x00, 0x00, 0x00, 0x00, 0x00, 0x00, 0x00, 0x00, 0x00, 0x00, 0x00, 0x00
};

// Pointer array - you would add all 212 frames from XERO here
const unsigned char* allFrames[] = {
  frame_idle_1, SPI OLED
  if(!display.begin(SSD1306_SWITCHCAPVC
};

void setup() {
  Serial.begin(115200);
  Serial.println("XERO Touch Control Starting...");

  // Initialize I2C OLED
  if(!display.begin(SSD1306_SWITCHCAPVCC, 0x3C)) {
    Serial.println(F("SSD1306 allocation failed"));
    for(;;);
  }

  // Setup touch sensor
  pinMode(TOUCH_PIN, INPUT);
  
  display.clearDisplay();
  display.setTextColor(SSD1306_WHITE);
  display.setTextSize(2);
  display.setCursor(10, 20);
  display.println("XERO+Touch");
  display.display();
  delay(2000);

  Serial.println("Ready! Touch to change animation.");
}

void loop() {
  checkTouch();
  updateAnimation();
}

void checkTouch() {
  bool currentTouch = digitalRead(TOUCH_PIN);
  
  // Detect rising edge (touch event)
  if (currentTouch && !lastTouchState) {
    lastTouchTime = millis();
    
    // Cycle to next animation
    currentAnimation++;
    if (currentAnimation > 4) {
      currentAnimation = 0;
    }
    
    // Reset to start of new animation
    currentFrame = animations[currentAnimation].startFrame;
    frameDelay = 1000 / animations[currentAnimation].fps;
    
    Serial.print("Animation: ");
    Serial.println(currentAnimation);
    
    delay(200); // Debounce
  }
  
  lastTouchState = currentTouch;
}

void updateAnimation() {
  unsigned long currentTime = millis();
  
  // Check if it's time for next frame
  if (currentTime - lastFrameTime >= frameDelay) {
    lastFrameTime = currentTime;
    
    // Draw current frame (for demo, alternating between 2 frames)
    display.clearDisplay();
    
    // In full version, you'd do: display.drawBitmap(0, 0, allFrames[currentFrame], 128, 64, 1);
    // For demo, using simple frame selection
    if (currentAnimation == 0) {
      display.drawBitmap(0, 0, frame_idle_1, 128, 64, 1);
    } else {
      display.drawBitmap(0, 0, frame_happy, 128, 64, 1);
    }
    
    // Show animation name at bottom
    display.setTextSize(1);
    display.setCursor(30, 56);
    switch(currentAnimation) {
      case 0: display.print("IDLE"); break;
      case 1: display.print("HAPPY"); break;
      case 2: display.print("SURPRISED"); break;
      case 3: display.print("SLEEPY"); break;
      case 4: display.print("LOVE"); break;
    }
    
    display.display();
    
    // Advance frame
    currentFrame++;
    AnimationSequence anim = animations[currentAnimation];
    
    if (currentFrame > anim.endFrame) {
      if (anim.loop) {
        currentFrame = anim.startFrame;
      } else {
        // Animation finished, go back to idle
        if (currentAnimation != 0) {
          currentAnimation = 0;
          currentFrame = animations[0].startFrame;
          frameDelay = 1000 / animations[0].fps;
        }
      }
    }
  }
}
